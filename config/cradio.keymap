/*
 * Zyra FT (Cradio/Sweep) keymap
 *
 * 34 klawisze, 4 warstwy: BASE, RIGHT (cyfry/nawigacja), LEFT (symbole), TRI (system)
 * Home-row mods: Shift/Alt/Ctrl/Gui na home row (A/S/D/F lewa, J/K/L/' prawa)
 * ZMK Studio kompatybilne (lewa = central, USB)
 *
 * Bez nice!view - pin D1 (P0.06) jest zajęty przez switch matrix Sweepa.
 *
 * TRI layer aktywuje się gdy oba thumb-layery (RIGHT i LEFT) są wciśnięte.
 *
 * studio_unlock = TRI layer + Q (czyli LT(2,TAB) + LT(1,BSPC) + Q)
 *
 * Here I have combined the FalbaTech Zyra FT repo with the relevant files from the Hands Down repo.
 *
 */

#include <behaviors.dtsi>
#include <dt-bindings/zmk/keys.h>
#include <dt-bindings/zmk/bt.h>
#include <dt-bindings/zmk/outputs.h>

#include "moutis/moutis_config.dtsi"    // my add-on feature defs

#include "keymaps/keynames_3x5_2.h"     // key name defs for this board topology
#include "layouts/vf-config.h"       // HD alpha keymap, adapt, and combo definitions


/ {
    /*
     * Behaviors
     */
    behaviors {

        #include "moutis/moutis_behaviors.dtsi" // common behaviors (hold-taps, mod-morphs, lingers, adaptives)
      //  #include HD_adapt_file                  // HDalpha/mnemonic based adaptives (most of them)

    };

    /*
     * Macros
     */
    macros {

        #include "moutis/moutis_macros.dtsi"    // common macros (superset)

    };

    /*
     * Combos
     */
    combos {
        compatible = "zmk,combos";

        #include "moutis/moutis_combos.dtsi"    // common/location based combos (cut/copy/paste, esc, app, etc.)
    //    #include HD_combo_file                  // HD alpha/mnemonic based combos (h-digraphs, etc.)

    };
    /*
     * Keymap (all layers w/references to all the above)
     */

    #include "keymaps/keymap_3x5_2.dtsi"    // consolidated keymap

};

// // Home-row mods - lewa ręka: Shift/Alt/Ctrl/Gui na A/S/D/F
// #define HRML(k1,k2,k3,k4) &ht LSHFT k1  &ht LALT k2  &ht LCTRL k3  &ht LGUI k4
// // Prawa ręka lustrzanie: Gui/Ctrl/Alt/Shift na J/K/L/'
// #define HRMR(k1,k2,k3,k4) &ht RGUI k1  &ht RCTRL k2  &ht RALT k3  &ht RSHFT k4
//
// / {
//     behaviors {
//         ht: hold_tap {
//             compatible = "zmk,behavior-hold-tap";
//             #binding-cells = <2>;
//             flavor = "tap-preferred";
//             tapping-term-ms = <220>;
//             quick-tap-ms = <150>;
//             require-prior-idle-ms = <100>;
//             bindings = <&kp>, <&kp>;
//         };
//     };
//
//     // Layer 1 (RIGHT) + Layer 2 (LEFT) jednocześnie -> Layer 3 (TRI)
//     conditional_layers {
//         compatible = "zmk,conditional-layers";
//         tri_layer {
//             if-layers = <1 2>;
//             then-layer = <3>;
//         };
//     };
//
//     keymap {
//         compatible = "zmk,keymap";
//
//         default_layer {
//             display-name = "Base";
//             bindings = <
//         //╭──────────┬──────────┬──────────┬──────────┬──────────╮   ╭──────────┬──────────┬──────────┬──────────┬──────────╮
//         //│  Q       │  W       │  E       │  R       │  T       │   │  Y       │  U       │  I       │  O       │  P       │
//             &kp Q      &kp W      &kp E      &kp R      &kp T          &kp Y      &kp U      &kp I      &kp O      &kp P
//         //├──────────┼──────────┼──────────┼──────────┼──────────┤   ├──────────┼──────────┼──────────┼──────────┼──────────┤
//         //│  A (Sft) │  S (Alt) │  D (Ctl) │  F (Gui) │  G       │   │  H       │  J (Gui) │  K (Ctl) │  L (Alt) │  ' (Sft) │
//             HRML(A,        S,         D,         F)     &kp G          &kp H      HRMR(J,        K,         L,        SQT)
//         //├──────────┼──────────┼──────────┼──────────┼──────────┤   ├──────────┼──────────┼──────────┼──────────┼──────────┤
//         //│  Z       │  X       │  C       │  V       │  B       │   │  N       │  M       │ , <      │ . >      │ / ?      │
//             &kp Z      &kp X      &kp C      &kp V      &kp B          &kp N      &kp M      &kp COMMA  &kp DOT    &kp FSLH
//         //╰──────────┴──────────┴──────────┼──────────┼──────────┤   ├──────────┼──────────┼──────────┴──────────┴──────────╯
//                                             &lt 2 TAB   &kp ENTER     &kp SPACE  &lt 1 BSPC
//         //                                 ╰──────────┴──────────╯   ╰──────────┴──────────╯
//             >;
//         };
//
//         right_layer {
//             display-name = "Right";
//             bindings = <
//         //╭──────────┬──────────┬──────────┬──────────┬──────────╮   ╭──────────┬──────────┬──────────┬──────────┬──────────╮
//         //│ INSERT   │  1       │  2       │  3       │          │   │ HOME     │ PAGE DN  │ PAGE UP  │ END      │  :       │
//             &kp INS    &kp N1     &kp N2     &kp N3     &trans         &kp HOME   &kp PG_DN  &kp PG_UP  &kp END    &kp COLON
//         //├──────────┼──────────┼──────────┼──────────┼──────────┤   ├──────────┼──────────┼──────────┼──────────┼──────────┤
//         //│ DELETE   │  4       │  5       │  6       │          │   │ LEFT     │ DOWN     │ UP       │ RIGHT    │  ;       │
//             &kp DEL    &kp N4     &kp N5     &kp N6     &trans         &kp LEFT   &kp DOWN   &kp UP     &kp RIGHT  &kp SEMI
//         //├──────────┼──────────┼──────────┼──────────┼──────────┤   ├──────────┼──────────┼──────────┼──────────┼──────────┤
//         //│ CAPS WORD│  7       │  8       │  9       │  0       │   │          │          │          │          │          │
//            &caps_word  &kp N7     &kp N8     &kp N9     &kp N0         &trans     &trans     &trans     &trans     &trans
//         //╰──────────┴──────────┴──────────┼──────────┼──────────┤   ├──────────┼──────────┼──────────┴──────────┴──────────╯
//                                              &trans     &kp ESC        &trans     &trans
//         //                                 ╰──────────┴──────────╯   ╰──────────┴──────────╯
//             >;
//         };
//
//         left_layer {
//             display-name = "Left";
//             bindings = <
//         //╭──────────┬──────────┬──────────┬──────────┬──────────╮   ╭──────────┬──────────┬──────────┬──────────┬──────────╮
//         //│          │  [       │  {       │  }       │          │   │  ^       │  (       │  )       │  ]       │  ~       │
//             &trans     &kp LBKT   &kp LBRC   &kp RBRC   &trans         &kp CARET  &kp LPAR   &kp RPAR   &kp RBKT   &kp TILDE
//         //├──────────┼──────────┼──────────┼──────────┼──────────┤   ├──────────┼──────────┼──────────┼──────────┼──────────┤
//         //│  !       │  @       │  #       │  $       │  %       │   │  *       │  -       │  =       │  \       │  `       │
//             &kp EXCL   &kp AT     &kp HASH   &kp DLLR   &kp PRCNT      &kp ASTRK  &kp MINUS  &kp EQUAL  &kp BSLH   &kp GRAVE
//         //├──────────┼──────────┼──────────┼──────────┼──────────┤   ├──────────┼──────────┼──────────┼──────────┼──────────┤
//         //│          │          │          │          │          │   │  &       │  _       │  +       │  │       │          │
//             &trans     &trans     &trans     &trans     &trans         &kp AMPS   &kp UNDER  &kp PLUS   &kp PIPE   &trans
//         //╰──────────┴──────────┴──────────┼──────────┼──────────┤   ├──────────┼──────────┼──────────┴──────────┴──────────╯
//                                              &trans     &trans         &trans     &trans
//         //                                 ╰──────────┴──────────╯   ╰──────────┴──────────╯
//             >;
//         };
//
//         tri_layer {
//             display-name = "Tri";
//             bindings = <
//         //╭──────────┬──────────┬──────────┬──────────┬──────────╮   ╭──────────┬──────────┬──────────┬──────────┬──────────╮
//         //│ STUDIO   │          │          │          │          │   │          │          │          │          │ RESET    │
//           &studio_unlock &trans     &trans     &trans     &trans         &trans     &trans     &trans     &trans     &sys_reset
//         //├──────────┼──────────┼──────────┼──────────┼──────────┤   ├──────────┼──────────┼──────────┼──────────┼──────────┤
//         //│ BOOT     │          │          │          │          │   │          │          │          │          │ BOOT     │
//           &bootloader  &trans       &trans     &trans     &trans         &trans     &trans     &trans     &trans   &bootloader
//         //├──────────┼──────────┼──────────┼──────────┼──────────┤   ├──────────┼──────────┼──────────┼──────────┼──────────┤
//         //│ BT 0     │ BT 1     │ BT 2     │ BT 3     │ BT 4     │   │ BT CLR   │ BT CLRALL│ USB      │ BLE      │          │
//         &bt BT_SEL 0 &bt BT_SEL 1 &bt BT_SEL 2 &bt BT_SEL 3 &bt BT_SEL 4   &bt BT_CLR &bt BT_CLR_ALL &out OUT_USB &out OUT_BLE &trans
//         //╰──────────┴──────────┴──────────┼──────────┼──────────┤   ├──────────┼──────────┼──────────┴──────────┴──────────╯
//                                              &trans     &trans         &trans     &trans
//         //                                 ╰──────────┴──────────╯   ╰──────────┴──────────╯
//             >;
//         };
//     };
// };
